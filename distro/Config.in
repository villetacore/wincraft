## distro/Config.in
```kconfig
menu "WinCraft OS"
source "$BR2_EXTERNAL_WINCRAFT_PATH/package/labwc/Config.in"
source "$BR2_EXTERNAL_WINCRAFT_PATH/package/wincraft/Config.in"
source "$BR2_EXTERNAL_WINCRAFT_PATH/package/wincraft-wine/Config.in"
endmenu
```

## distro/configs/wincraft_qemu_x86_64_defconfig
```kconfig
BR2_x86_64=y
BR2_x86_x86_64_v2=y
BR2_PACKAGE_HOST_LINUX_HEADERS_CUSTOM_6_18=y
BR2_TOOLCHAIN_BUILDROOT_CXX=y
BR2_DL_DIR="/work/state/dl"
BR2_CCACHE=y
BR2_CCACHE_DIR="/work/state/ccache"
BR2_GLOBAL_PATCH_DIR="$(BR2_EXTERNAL_WINCRAFT_PATH)/patches"
BR2_TARGET_GENERIC_HOSTNAME="wincraft"
BR2_TARGET_GENERIC_ISSUE="WinCraft OS"
BR2_INIT_NONE=y
BR2_ROOTFS_DEVICE_CREATION_DYNAMIC_EUDEV=y
BR2_ROOTFS_DEVICE_TABLE="system/device_table.txt $(BR2_EXTERNAL_WINCRAFT_PATH)/board/qemu-x86_64/permissions.table"
BR2_SYSTEM_BIN_SH_BASH=y
# BR2_TARGET_GENERIC_GETTY is not set
BR2_ENABLE_LOCALE_WHITELIST="C en_US ru_RU"
BR2_GENERATE_LOCALE="en_US.UTF-8 ru_RU.UTF-8"
BR2_TARGET_TZ_INFO=y
BR2_ROOTFS_USERS_TABLES="$(BR2_EXTERNAL_WINCRAFT_PATH)/board/qemu-x86_64/users.table"
BR2_ROOTFS_OVERLAY="$(BR2_EXTERNAL_WINCRAFT_PATH)/board/qemu-x86_64/rootfs-overlay"
BR2_ROOTFS_POST_BUILD_SCRIPT="$(BR2_EXTERNAL_WINCRAFT_PATH)/board/qemu-x86_64/post-build.sh"
BR2_ROOTFS_POST_IMAGE_SCRIPT="$(BR2_EXTERNAL_WINCRAFT_PATH)/board/qemu-x86_64/post-image.sh"
BR2_LINUX_KERNEL=y
BR2_LINUX_KERNEL_CUSTOM_VERSION=y
BR2_LINUX_KERNEL_CUSTOM_VERSION_VALUE="6.18.56"
BR2_LINUX_KERNEL_DEFCONFIG="x86_64"
BR2_LINUX_KERNEL_CONFIG_FRAGMENT_FILES="$(BR2_EXTERNAL_WINCRAFT_PATH)/board/qemu-x86_64/linux.fragment"
BR2_LINUX_KERNEL_NEEDS_HOST_OPENSSL=y
BR2_LINUX_KERNEL_NEEDS_HOST_LIBELF=y
BR2_PACKAGE_BUSYBOX_SHOW_OTHERS=y
BR2_PACKAGE_ALSA_UTILS=y
BR2_PACKAGE_FINDUTILS=y
BR2_PACKAGE_GREP=y
BR2_PACKAGE_E2FSPROGS=y
BR2_PACKAGE_DEJAVU=y
BR2_PACKAGE_MESA3D=y
BR2_PACKAGE_MESA3D_LLVM=y
BR2_PACKAGE_MESA3D_GALLIUM_DRIVER_LLVMPIPE=y
BR2_PACKAGE_MESA3D_OPENGL_GLX=y
BR2_PACKAGE_MESA3D_OPENGL_EGL=y
BR2_PACKAGE_MESA3D_OPENGL_ES=y
BR2_PACKAGE_MESA3D_GBM=y
# Display server: Wayland (labwc on wlroots), X11 programs and Wine through XWayland (ADR-018)
BR2_PACKAGE_XORG7=y
BR2_PACKAGE_XLIB_LIBXCOMPOSITE=y
BR2_PACKAGE_WAYLAND=y
BR2_PACKAGE_WAYLAND_PROTOCOLS=y
BR2_PACKAGE_WLROOTS=y
BR2_PACKAGE_WLROOTS_XWAYLAND=y
BR2_PACKAGE_XWAYLAND=y
BR2_PACKAGE_SEATD=y
BR2_PACKAGE_SEATD_DAEMON=y
BR2_PACKAGE_LABWC=y
BR2_PACKAGE_FOOT=y
BR2_PACKAGE_WLR_RANDR=y
# Browser engine for WinCraft Browser (apps/browser): WebKitGTK on GTK4/Wayland,
# HTTPS (glib-networking, GnuTLS), audio/video through GStreamer (ALSA, ffmpeg decoders)
BR2_PACKAGE_LIBGTK4=y
BR2_PACKAGE_LIBGTK4_WAYLAND=y
BR2_PACKAGE_WEBKITGTK=y
BR2_PACKAGE_WEBKITGTK_WAYLAND=y
BR2_PACKAGE_WEBKITGTK_HTTPS=y
BR2_PACKAGE_WEBKITGTK_MULTIMEDIA=y
BR2_PACKAGE_GLIB_NETWORKING=y
BR2_PACKAGE_GST1_PLUGINS_GOOD=y
BR2_PACKAGE_GST1_LIBAV=y
BR2_PACKAGE_CA_CERTIFICATES=y
BR2_PACKAGE_GNUTLS=y
BR2_PACKAGE_FILE=y
BR2_PACKAGE_COREUTILS=y
BR2_PACKAGE_HTOP=y
BR2_PACKAGE_UTIL_LINUX_BINARIES=y
BR2_PACKAGE_UTIL_LINUX_MOUNT=y
BR2_PACKAGE_LESS=y
BR2_PACKAGE_NANO=y
BR2_TARGET_ROOTFS_SQUASHFS=y
BR2_TARGET_ROOTFS_SQUASHFS4_ZSTD=y
# BR2_TARGET_ROOTFS_TAR is not set
BR2_PACKAGE_WINCRAFT=y
BR2_PACKAGE_WINCRAFT_WINE=y
```

## distro/package/labwc/Config.in
```kconfig
config BR2_PACKAGE_LABWC
	bool "labwc"
	depends on BR2_PACKAGE_WLROOTS
	select BR2_PACKAGE_CAIRO
	select BR2_PACKAGE_CAIRO_PNG
	select BR2_PACKAGE_LIBGLIB2
	select BR2_PACKAGE_LIBPNG
	select BR2_PACKAGE_LIBXML2
	select BR2_PACKAGE_PANGO
	help
	  Window-stacking Wayland compositor based on wlroots, with
	  Openbox-compatible rc.xml and themes. WinCraft's display server
	  and window manager (it replaces Xorg + Openbox); X11 and Windows
	  programs run through XWayland.

	  https://labwc.github.io
```

## distro/package/wincraft/Config.in
```kconfig
config BR2_PACKAGE_WINCRAFT
	bool "wincraft (system and shell)"
	depends on BR2_x86_64
	depends on BR2_PACKAGE_WLROOTS_XWAYLAND
	depends on BR2_PACKAGE_WEBKITGTK # browser
	depends on BR2_PACKAGE_LIBGTK4_WAYLAND # browser
	select BR2_PACKAGE_LABWC
	select BR2_PACKAGE_SEATD
	select BR2_PACKAGE_SEATD_DAEMON
	select BR2_PACKAGE_WAYLAND
	select BR2_PACKAGE_LIBXKBCOMMON
	select BR2_PACKAGE_XKEYBOARD_CONFIG
	select BR2_PACKAGE_XDATA_XCURSOR_THEMES
	select BR2_PACKAGE_FOOT
	select BR2_PACKAGE_WLR_RANDR
	help
	  WinCraft's own Rust components: wincraft-boot (initramfs stage),
	  wincraft-init (PID 1), winlogon (session), explorer (shell),
	  notepad, taskmgr, start (launcher) and browser (WebKitGTK). Built from this repository with the build
	  host's Rust toolchain against the Buildroot sysroot.

	  The session runs on Wayland (ADR-018): seatd hands the devices
	  to labwc, which runs as the user; the shell's desktop and taskbar
	  are layer-shell surfaces, X11 and Windows programs use XWayland.
```
